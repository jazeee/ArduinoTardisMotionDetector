#include <PCM.h>
#include "printf.h"

const unsigned char sample[] PROGMEM = {
  125, 126, 128, 129, 129, 128, 128, 129, 128, 127, 128, 127,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 136, 
};

const int ledPin =  13;      // the number of the LED pin
const int motionSensorPin = 2;
const int motionLedPin = 3;

int ledState = HIGH;             // ledState used to set the LED

unsigned long previousMillis = 0;        // will store last time LED was updated

int previousMotion = 0;
unsigned long  previousPlayback = 1000;
int playbackCount = 0;

const long interval = 500;           // interval at which to blink (milliseconds)

void setup()
{
  // set the digital pin as output:
  pinMode(ledPin, OUTPUT);
  pinMode(motionSensorPin, INPUT);
  pinMode(motionLedPin, OUTPUT);
  Serial.begin(57600);
  printf_begin();
  printf("\n\rStarted...\n\r");
 	digitalWrite(ledPin, ledState);
 	digitalWrite(motionLedPin, 1);
}

void loop()
{
  unsigned long currentMillis = millis();

  if (currentMillis - previousMillis >= interval) {
    previousMillis = currentMillis;
    if (ledState == LOW) {
      ledState = HIGH;
    } else {
      ledState = LOW;
    }
    digitalWrite(ledPin, ledState);
  }
  int motion = digitalRead(motionSensorPin);
  if(motion != previousMotion){
  	printf("\n\rMotion Changed: %d at %ld\n", motion, currentMillis);
  	previousMotion = motion;
  	digitalWrite(motionLedPin, !motion);
  }
	if(motion){
		if( currentMillis - previousPlayback >= 2500 && playbackCount < 10){
			playbackCount++;
			printf("Playing Sample: %d\n", playbackCount);
			startPlayback(sample, sizeof(sample));
			previousPlayback = currentMillis;
		}
	} else {
		playbackCount = 0;
	}
}


